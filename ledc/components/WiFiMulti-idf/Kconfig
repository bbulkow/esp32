## ledc/components/WiFiMulti-idf/Kconfig
```kconfig
menu "WiFiMulti"

    config WIFI_MULTI_TEST
        bool "Create a Wifi Multi LED option in case I need to later"
        default n
        help
            I don't know if I'm going to have to add menuconfig options in the future.
            Maybe I will. If I do, this is the template for doing it.

endmenu
```
